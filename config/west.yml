## config/west.yml
```yaml
manifest:
  defaults:
    revision: v0.3
  remotes:
    - name: zmkfirmware
      url-base: https://github.com/zmkfirmware
    - name: petejohanson
      url-base: https://github.com/petejohanson/
    - name: caksoylar
      url-base: https://github.com/caksoylar
    - name: geeksville
      url-base: https://github.com/geeksville
    - name: halfdane
      url-base: https://github.com/halfdane/
    - name: prospector
      url-base: https://github.com/t-ogura
  projects:
    - name: zmk
      remote: zmkfirmware
      revision: main
      import: app/west.yml
    # - name: cirque-input-module
    #   remote: petejohanson
    #   revision: main
    - name: cirque-input-module
      remote: geeksville
      revision: main 
    # # Add this:
    # - name: zmk-input-gestures
    #   remote: halfdane
    #   revision: main
    # # Add these if you want to use absolute mode:
    # - name: zmk-input-processors
    #   remote: halfdane
    #   revision: main
    # - name: cirque-input-module
    #   remote: halfdane
    #   revision: absolute_mode
    - name: zmk-rgbled-widget
      remote: caksoylar
      #revision: main
      revision: v0.3
    - name: prospector-zmk-module
      remote: prospector
      revision: v2.0.0
      path: modules/prospector-zmk-module
  self:
    path: config
```
